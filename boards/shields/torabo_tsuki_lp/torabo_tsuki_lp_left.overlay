#include "torabo_tsuki_lp.dtsi"
#include <input/processors.dtsi>
#include <dt-bindings/zmk/input_transform.h>

&pointing_listener {
    // 通常時：カーソル移動 + トラックボール操作時にレイヤー4(mouse)を一時ON
    input-processors =
        // <&zip_temp_layer 4 800>,
        <&zip_xy_transform (INPUT_TRANSFORM_X_INVERT | INPUT_TRANSFORM_Y_INVERT)>,
        <&zip_xy_scaler 1 2>;

    // レイヤー3が有効な間だけ：トラックボールをスクロール化
    scroll_layer {
        layers = <3>;
        input-processors =
            <&zip_xy_transform (INPUT_TRANSFORM_X_INVERT)>,
            <&zip_xy_scaler 1 3>,
            <&zip_xy_to_scroll_mapper>;
    };
};
